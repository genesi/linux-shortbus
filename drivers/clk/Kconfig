## drivers/clk/Kconfig
```kconfig
config CLKDEV_LOOKUP
	bool
	select HAVE_CLK

config USE_COMMON_STRUCT_CLK
	bool

config CLK_DEBUG
	bool "Export clock debug information through debugfs"
	depends on USE_COMMON_STRUCT_CLK && PM_DEBUG &&DEBUG_FS

config USE_COMMON_CLK_DIVIDER
	bool

config USE_COMMON_CLK_FACTOR_FIXED
	bool

config USE_COMMON_CLK_MUX
	bool

config USE_COMMON_CLK_GATE
	bool
```

## drivers/media/video/mxc/output/Kconfig
```kconfig
config VIDEO_MXC_IPU_OUTPUT
	bool "IPU v4l2 support"
	depends on VIDEO_MXC_OUTPUT && MXC_IPU && FB_MXC
	default y
	---help---
	  This is the video4linux2 driver for IPU post processing video output.
```

## drivers/mxc/Kconfig
```kconfig
# drivers/video/mxc/Kconfig

if ARCH_MXC

menu "MXC support drivers"
source "drivers/mxc/vpu/Kconfig"
source "drivers/mxc/amd-gpu/Kconfig"
endmenu

endif
```

## drivers/mxc/amd-gpu/Kconfig
```kconfig
#
# Bluetooth configuration
#

menu "MXC GPU support"

config MXC_AMD_GPU
	tristate "MXC GPU support"
	depends on ARCH_MX35 || ARCH_MX5
	---help---
         Say Y to get the GPU driver support.

endmenu
```

## drivers/video/mxc/Kconfig
```kconfig
config FB_MXC
	tristate "MXC Framebuffer support"
	depends on FB && (MXC_IPU || ARCH_MX21 || ARCH_MX27 || ARCH_MX25)
	select FB_CFB_FILLRECT
	select FB_CFB_COPYAREA
	select FB_CFB_IMAGEBLIT
	default y
	help
	  This is a framebuffer device for the MXC LCD Controller.
	  See <http://www.linux-fbdev.org/> for information on framebuffer
	  devices.

	  If you plan to use the LCD display with your MXC system, say
	  Y here.

config FB_MXC_SYNC_PANEL
	depends on FB_MXC
	tristate "Synchronous Panel Framebuffer"
	default y

config FB_MXC_TVOUT_TVE
	tristate "MXC TVE TV Out Encoder"
	depends on FB_MXC_SYNC_PANEL
	depends on MXC_IPU_V3

config FB_MXC_SII902X
	depends on FB_MXC_SYNC_PANEL
	select FB_MODE_HELPERS
	tristate "Si Image SII9022 DVI/HDMI Interface Chip"

config FB_MXC_SIIHDMI
	depends on FB_MXC_SYNC_PANEL && MACH_MX51_EFIKAMX
	select FB_MODE_HELPERS
	tristate "SII9xxx HDMI Interface Chips (Advanced)"

config FB_MXC_SIIHDMI_HOTPLUG
	depends on FB_MXC_SIIHDMI
	bool "Hotplugging HDMI connector support (EXPERIMETNAL)"

config FB_MXC_LDB
	tristate "MXC LDB"
	depends on FB_MXC_SYNC_PANEL
	depends on MXC_IPU_V3
```
